## app/boards/shields/keychron/Kconfig.defconfig
```kconfig
# Copyright (c) 2024
# SPDX-License-Identifier: MIT

if SHIELD_KEYCHRON_V1MAX

config ZMK_KEYBOARD_NAME
    default "Keychron V1 Max"
config ZMK_LED_INIT_PRIORITY
    int "LED Init Priority"
    default 40
endif
```

## app/boards/shields/keychron/Kconfig.shield
```kconfig
# Copyright (c) 2024
# SPDX-License-Identifier: MIT

config SHIELD_KEYCHRON_V1MAX
    bool

config ENABLE_WIN_LOCK
    bool

config ENABLE_WIN_LOCK_INDICATOR
    bool
    depends on ENABLE_WIN_LOCK

config ENABLE_GPIO_LED
    bool

config ENABLE_NKRO_LED_FLASH
    bool

config KEYCHRON_RGB_ENABLE
    bool

config SNAP_CLICK_ENABLE
    bool

config RETAIL_DEMO_ENABLE
    bool

config SOFTWARE_SWITCH_LAYER
    bool

config MAC_VIA_FUNC
    bool

config CHANGE_REPORT_RATE
    bool

config ADAPATIVE_NKRO
   bool

config FAST_KSCAN
    bool

config ADD_PPT_REPORT_RATE
    bool

config COL_595_OUTPUT
    bool
config COL_595_AND_GPIOS_OUTPUT
    bool

config ENABLE_FLASH_PROTECT
    bool

config KEYCHRON_FWU_STRING_NAME
    string "Keychron FWU string name"

config ZMK_LED_INIT_PRIORITY
    int "LED Init Priority"
    default 40
```

## app/boards/shields/keychron/b1/us/Kconfig.defconfig
```kconfig
if SHIELD_KEYCHRON_B1_US

config USB_DEVICE_VID
    default 0x03F0

config USB_DEVICE_PID
    default 0x564A

config ZMK_KEYBOARD_NAME
    default "HP Keyboard"

endif
```

## app/boards/shields/keychron_k3se2_ansi/Kconfig.shield
```kconfig
config SHIELD_KEYCHRON_K3SE2_ANSI
    def_bool $(shields_list_contains,keychron_k3se2_ansi)
    select SHIELD_KEYCHRON_V1MAX
    select ENABLE_GPIO_LED
    select MAC_VIA_FUNC
    select ADD_PPT_REPORT_RATE
    select COL_595_OUTPUT
    select ADAPATIVE_NKRO
```

## app/boards/shields/keychron_q3_ultra_ansi/Kconfig.shield
```kconfig
config SHIELD_KEYCHRON_Q3_ULTRA_ANSI
    def_bool $(shields_list_contains,keychron_q3_ultra_ansi)
    select SHIELD_KEYCHRON_V1MAX
    select KEYCHRON_RGB_ENABLE
    select SNAP_CLICK_ENABLE
    select RETAIL_DEMO_ENABLE
    select ADAPATIVE_NKRO
    select MAC_VIA_FUNC
    # select FAST_KSCAN
    select ADD_PPT_REPORT_RATE
    select ENABLE_GPIO_LED
```

## app/boards/shields/keychron_q6_ultra_ansi/Kconfig.shield
```kconfig
config SHIELD_KEYCHRON_Q6_ULTRA_ANSI
    def_bool $(shields_list_contains,keychron_q6_ultra_ansi)
    select SHIELD_KEYCHRON_V1MAX
    select KEYCHRON_RGB_ENABLE
    select SNAP_CLICK_ENABLE
    select RETAIL_DEMO_ENABLE
    select ADAPATIVE_NKRO
    select MAC_VIA_FUNC
    # select FAST_KSCAN
    select ADD_PPT_REPORT_RATE
    select ENABLE_GPIO_LED
```

## app/boards/shields/keychron_v1_ultra_ansi/Kconfig.shield
```kconfig
config SHIELD_KEYCHRON_V1_ULTRA_ANSI
    def_bool $(shields_list_contains,keychron_v1_ultra_ansi)
    select SHIELD_KEYCHRON_V1MAX
    select KEYCHRON_RGB_ENABLE
    select SNAP_CLICK_ENABLE
    select RETAIL_DEMO_ENABLE
    # select FAST_KSCAN
    select ADD_PPT_REPORT_RATE
    select ENABLE_GPIO_LED
    select ENABLE_FLASH_PROTECT
    select ADAPATIVE_NKRO
```

## app/boards/shields/keychron_v1_ultra_iso/Kconfig.shield
```kconfig
config SHIELD_KEYCHRON_V1_ULTRA_ISO
    def_bool $(shields_list_contains,keychron_v1_ultra_iso)
    select SHIELD_KEYCHRON_V1MAX
    select KEYCHRON_RGB_ENABLE
    select SNAP_CLICK_ENABLE
    select RETAIL_DEMO_ENABLE
    select FAST_KSCAN
    select ADD_PPT_REPORT_RATE
    select ADAPATIVE_NKRO
```

## app/boards/shields/keychron_v1_ultra_jis/Kconfig.shield
```kconfig
config SHIELD_KEYCHRON_V1_ULTRA_JIS
    def_bool $(shields_list_contains,keychron_v1_ultra_jis)
    select SHIELD_KEYCHRON_V1MAX
    select KEYCHRON_RGB_ENABLE
    select SNAP_CLICK_ENABLE
    select RETAIL_DEMO_ENABLE
    select FAST_KSCAN
    select ADD_PPT_REPORT_RATE
    select ADAPATIVE_NKRO
```

## app/boards/shields/keychron_v2_ultra_ansi/Kconfig.shield
```kconfig
config SHIELD_KEYCHRON_V2_ULTRA_ANSI
    def_bool $(shields_list_contains,keychron_v2_ultra_ansi)
    select SHIELD_KEYCHRON_V1MAX
    select KEYCHRON_RGB_ENABLE
    select SNAP_CLICK_ENABLE
    select RETAIL_DEMO_ENABLE
    select ADAPATIVE_NKRO
```

## app/boards/shields/keychron_z270_ultra_ansi/Kconfig.shield
```kconfig
config SHIELD_KEYCHRON_Z270_ANSI
    def_bool $(shields_list_contains,keychron_z270_ultra_ansi)
    select SHIELD_KEYCHRON_V1MAX
    select KEYCHRON_RGB_ENABLE
    select SNAP_CLICK_ENABLE
    select RETAIL_DEMO_ENABLE
    select ADD_PPT_REPORT_RATE
    select ENABLE_GPIO_LED
    select ENABLE_FLASH_PROTECT
    select ADAPATIVE_NKRO
```

## app/dts/bindings/behaviors/zmk,behavior-keychron.yaml
```yaml
# Copyright (c) 2020 The ZMK Contributors
# SPDX-License-Identifier: MIT

description: Keychron Behavior

compatible: "zmk,behavior-keychron"

include: two_param.yaml
```

## app/dts/bindings/behaviors/zmk,behavior-tap-dance1.yaml
```yaml
# Copyright (c) 2022 The ZMK Contributors
# SPDX-License-Identifier: MIT

description: Tap Dance Behavior

compatible: "zmk,behavior-tap-dance1"

include: one_param.yaml

properties:
  bindings:
    type: phandle-array
    required: true
  tapping-term-ms:
    type: int
    default: 200
```

## app/module/drivers/led_strip/Kconfig.ckled2001
```kconfig
# Copyright (c) 2022 The ZMK Contributors
# SPDX-License-Identifier: MIT

DT_COMPAT_ZMK_CKLED2001 := zmk,ckled2001

config CKLED2001
	bool "CKLED2001 compatible LED strip controller driver"
	default $(dt_compat_enabled,$(DT_COMPAT_ZMK_CKLED2001))
	#depends on I2C
	depends on LED_STRIP
	help
	  Enable driver for CKLED2001 compatible LED strip controller.
	  
config CKLED2001_INIT_PRIORITY
	int "device init priority"
	default 90

config CKLED2001_I2C
	bool "use i2c"
	default n
	select I2C 

config CKLED2001_SPI
	bool "use spi"
	default n
	select SPI 
```

## app/module/drivers/led_strip/Kconfig.sn3734
```kconfig
# Copyright (c) 2022 The ZMK Contributors
# SPDX-License-Identifier: MIT

DT_COMPAT_ZMK_SN3734 := zmk,sn3734

config SN3734
	bool "SN3734 compatible LED strip controller driver"
	default $(dt_compat_enabled,$(DT_COMPAT_ZMK_SN3734))
	#depends on I2C
	depends on LED_STRIP
	help
	  Enable driver for SN3734 compatible LED strip controller.
	  
config SN3734_INIT_PRIORITY
	int "device init priority"
	default 90

config SN3734_I2C
	bool "use i2c"
	default n
	select I2C 

config SN3734_SPI
	bool "use spi"
	default n
	select SPI 
```

## app/module/dts/bindings/led_strip/zmk,sn3734.yaml
```yaml
# Copyright (c) 2022 The ZMK Contributors
# SPDX-License-Identifier: MIT

description: SN3734 LED strip controller

compatible: "zmk,sn3734"

include: [spi-device.yaml,pinctrl-device.yaml]

properties:
  label:
    type: string
    # required: true

  chain-length:
    type: int
    required: true


  map:
    type: array
    required: true
    
  current_tune:
    type: array
    #required: true

  pwrctrl-gpios:
    type: phandle-array
    required: true
    description: SDB pin.

  pinctrl-0:
    required: true

  pinctrl-names:
    required: true
```

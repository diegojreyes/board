/*
 * Copyright (c) 2020 The ZMK Contributors
 *
 * SPDX-License-Identifier: MIT
 */

/ {
    behaviors {
        /omit-if-no-ref/ kc: keychron {
            compatible = "zmk,behavior-keychron";
            #binding-cells = <2>;
        };
    };
};
